## drivers/Kconfig
```kconfig
# Copyright (c) 2021
# SPDX-License-Identifier: Apache-2.0

menu "Drivers"
rsource "display/Kconfig"
endmenu
```

## drivers/display/Kconfig
```kconfig
# Copyright (c) 2021 Farit N
# SPDX-License-Identifier: Apache-2.0

config HT1632C
    bool "HT1632C display"
    help
      Enable HT1632C display
```

## dts/bindings/display/holtek,ht1632c.yaml
```yaml
# Copyright (c) 2021 Farit N
# SPDX-License-Identifier: Apache-2.0

description:  Holtek HT1632C display controller

compatible: "holtek,ht1632c"

include: base.yaml

properties:
    cs-gpios:
      type: phandle-array
      required: true
      description: GPIO to which the CS pin of HT1632C is connected.

    wr-gpios:
      type: phandle-array
      required: true
      description: GPIO to which the WR pin of HT1632C is connected.

    data-gpios:
      type: phandle-array
      required: true
      description: GPIO to which the DATA pin of HT1632C is connected.

    commons-options:
      type: int
      required: true
      default: 0x00
      description: |
        0x00: N-MOS  opendrain output and 8 common option
        0x01: N-MOS  opendrain  output  and  16 common option
        0x10: P-MOS  opendrain output and 8 common option
        0x11: P-MOS  opendrain  output  and  16 common option
```

## west.yml
```yaml
# Copyright (c) 2021 
# SPDX-License-Identifier: Apache-2.0

manifest:
  self:
    path: ht1632c

  remotes:
    - name: zephyrproject-rtos
      url-base: https://github.com/zephyrproject-rtos

  projects:
    - name: zephyr
      remote: zephyrproject-rtos
      revision: main
      import: true
```
